/*@!Encoding:1258*/
includes {
  #include "CANTP_library2.can"
}

on start {
  CanTp_ResetToIdle();
  rx_can_id = 0x456;
  tx_can_id = 0x123;
}


on key 'a' {
  byte data[50];
  int i;
  for (i = 0; i < 50; i++) {
    data[i] = i;
  }
  CanTp_Transmit(tx_can_id, data, 50);
  write("Triggered transmission of 50-byte message on CAN ID 0x123");
}

on message * {
  if (this.dir == RX && (this.id == rx_can_id || rx_can_id == 0)) {
    byte pci;
    int frame_type;
    byte payload[8];
    pci = this.byte(0);
    frame_type = (pci & 0xF0) >> 4;
    for (i = 0; i < 8; i++) {
      payload[i] = this.byte(i);
    }
    switch (frame_type) {
      case 0: /* Single Frame */
        CanTp_HandleSingleFrame(this.id, payload);
        break;
      case 1: /* First Frame */
        CanTp_HandleFirstFrame(this.id, payload);
        break;
      case 2: /* Consecutive Frame */
        CanTp_HandleConsecutiveFrame(this.id, payload);
        break;
      case 3: /* Flow Control */
        CanTp_HandleFlowControl(this.id, payload);
        break;
    }
  }
}