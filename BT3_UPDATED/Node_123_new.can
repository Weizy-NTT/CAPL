/*@!Encoding:65001*/
includes {
  #include "CANTP_library.can"
}


on start {
  CanTp_ResetToIdle();
  rx_can_id = 0x456;
  tx_can_id = 0x123;
}



on sysvar  Node_1::STmin_Node123
{
  default_st_min = @ Node_1::STmin_Node123;
}

on sysvar  Node_1::BS_Node123
{
  default_block_size = @ Node_1::BS_Node123;
}

on sysvar  Node_1::Data_Node123
{
  default_Data = @ Node_1::Data_Node123;
}

on sysvar  Node_1::FS_Node123
{
  default_Fs = @ Node_1::FS_Node123;
}

on key 'a' {
  byte data[1000];
  int i;
  for (i = 0; i < default_Data; i++) {
    data[i] = i;
  }
  CanTp_Transmit(tx_can_id, data, default_Data);
  write("Triggered transmission of 50-byte message on CAN ID 0x123");
}

on message * {
  if (this.dir == RX && (this.id == rx_can_id || rx_can_id == 0)) {
    byte pci;
    int frame_type;
    byte payload[8];
    pci = this.byte(0);
    frame_type = (pci & 0xF0) >> 4;
    for (i = 0; i < 8; i++) {
      payload[i] = this.byte(i);
    }
    switch (frame_type) {
      case 0: /* Single Frame */
        CanTp_HandleSingleFrame(this.id, payload);
        break;
      case 1: /* First Frame */
        CanTp_HandleFirstFrame(this.id, payload);
        break;
      case 2: /* Consecutive Frame */
        CanTp_HandleConsecutiveFrame(this.id, payload);
        break;
      case 3: /* Flow Control */
        CanTp_HandleFlowControl(this.id, payload);
        break;
    }
  }
}

