/*@!Encoding:65001*/
/* CANTP_Node2.can - CAPL Implementation for Node 2 (Receiver) of CAN Transport Protocol (ISO 15765-2)
 * Listens for FF and CF messages, sends FC frames to continue CF transmission
 * Compatible with Node 1 (CANTP.can) for diagnostic testing
 */

/* Global Variables */
variables {
  /* CAN IDs */
  dword rx_can_id = 0x123; /* Receive from Node 1 */
  dword tx_can_id = 0x456; /* Send FC to Node 1 */

  /* Receive Buffer and State */
  byte rx_data[4095];      /* Buffer for received data */
  int rx_length = 0;       /* Current received length */
  int rx_expected_length = 0; /* Total expected length from FF */
  int sequence_number = 0; /* Expected CF sequence number */
  int cf_received = 0;     /* Number of CFs received in current block */

  /* Loop variable */
  int i;
}

/* Handle Incoming Messages */
on message 0x123 {
  byte pci;
  int frame_type, sn;
  pci= this.byte(0);
  frame_type = (pci & 0xF0) >> 4;

  if (frame_type == 1) { /* First Frame (FF) */
    rx_expected_length = ((pci & 0x0F) << 8) | this.byte(1);
    rx_length = 0;
    for (i = 0; i < 6; i++) {
      rx_data[rx_length + i] = this.byte(i + 2);
    }
    rx_length = 6;
    sequence_number = 0;
    cf_received = 0;
    write("Received FF: Expected Length=%d", rx_expected_length);
    SendFlowControl();
  } else if (frame_type == 2) { /* Consecutive Frame (CF) */
    sn = pci & 0x0F;
    if (sn == (sequence_number + 1) % 16) {
      sequence_number = sn;
      for (i = 0; i < 7 && rx_length < rx_expected_length; i++) {
        rx_data[rx_length] = this.byte(i + 1);
        rx_length++;
      }
      cf_received++;
      write("Received CF: SN=%d, Total Length=%d", sn, rx_length);
      if (rx_length >= rx_expected_length) {
        write("Message Complete: Received %d bytes", rx_length);
        rx_length = 0;
        rx_expected_length = 0;
        sequence_number = 0;
        cf_received = 0;
      } else if (cf_received >= 2) { /* BS=2 */
        SendFlowControl();
        cf_received = 0;
      }
    } else {
      write("Invalid CF SN: Expected %d, Received %d", (sequence_number + 1) % 16, sn);
    }
  }
}

/* Send Flow Control Frame */
SendFlowControl() {
  message 0x456 fc_msg;
  fc_msg.dlc = 8;
  fc_msg.byte(0) = 0x30; /* CTS */
  fc_msg.byte(1) = 2; /* BS=2 */
  fc_msg.byte(2) = 10; /* STmin=10ms */
  for (i = 3; i < 8; i++) {
    fc_msg.byte(i) = 0x55; /* Padding */
  }
  output(fc_msg);
  write("Sent FC: FS=CTS, BS=2, STmin=10ms");
}